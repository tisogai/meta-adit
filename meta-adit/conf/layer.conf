## meta-adit/conf/layer.conf
```bitbake
# We have a conf and classes directory, append to BBPATH
BBPATH .= ":${LAYERDIR}"

# We have a recipes directory, add to BBFILES
BBFILES += "${LAYERDIR}/recipes*/*/*.bb ${LAYERDIR}/recipes*/*/*.bbappend"

BBFILE_COLLECTIONS += "meta-adit"
BBFILE_PATTERN_meta-adit := "^${LAYERDIR}/"
BBFILE_PRIORITY_meta-adit = "16"
```
